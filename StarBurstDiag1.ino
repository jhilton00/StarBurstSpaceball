// StarBurstDiag1.ino: StarBurst Spaceball Diagnostics
//
// PURPOSE
// =======
// To provide two diagnostic modes plus a DAC test to aid hardware
// debugging.
//
// In the powerup "SINGLE" mode one of the six LEDs is continuously
// powered to aid circuit debugging while regularly outputting that
// optical sensor's information.
//
// In the "SIX" mode all six optical sensor's ADC readings are regularly
// output.
//
// A "D" (DAC test) command sets the DAC to all 256 8-bit values and
// prints the resulting LED drive resistor's ADC voltage reading along
// with the active sensor's photodiode ADC value and current.
//
// For more information visit reddit.com/r/StarBurstSpaceball
//
// OVERVIEW
// ========
// This overview specifies the program's conceptual Types, Properties,
// Commands and Output. Actual code may differ slightly.
//  ---------Types
//    DACSetting
//        Contains 2-bit values for each of the four DAC pins.
//  ----------Properties
//    <state>
//        SINGLE
//            The LED specified by <sensor> is turned on and the reading
//            is regularly ouput.
//        SIX
//            All six readings are regularly output.
//        In both states the sense/print cycle executes at the specified
//        <rate>.
//    <sensor>
//        A value between 1 and 6 specifying the SINGLE state's active
//        sensor.
//    <dacSettings[6]>
//        Six 8-bit values specifying the DAC settings for each sensor.
//    <rate>
//        Specifies the number of SINGLE or SIX sense/print cycles over a 10
//        second period with a range from 0 (off) to 600 (60Hz).
//    <readings[6]>
//        Readings 1 through 6.
//        Readonly values. In the SINGLE mode only <readings[<sensor>]> is
//        regularly printed. In the SIX mode all six readings are regularly
//        printed.
//    <vLEDDrive>
//        Readonly ADC value for the the 27 ohm R12 resistor. Only output in
//        response to a "D" command.
//  ----------Commands
//    Notes:
//        [] indicates optional parameters.
//        Commands are case insensitive.
//    “S[<sensor>[<dacSetting>]]”
//        <sensor> = <sensor>
//        <dacSettings[<sensor>-1]> = <dacSetting>
//        Responds with a sense/print cycle.
//    “1”
//        <state> = SINGLE
//        Responds with a sense/print cycle.
//    “6”
//        <state> = SIX
//        Responds with a sense/print cycle.
//    “R<rate>”
//        <rate> = <rate>
//        Responds with a sense/print cycle.
//    "D"
//        Perform a DAC test by sequentially setting the DAC from 0 to 255
//        and printing the resulting <vLEDDrive>, the corresponding mA LED
//        current, the ADC sensor reading and the corresponding µA
//        photodiode current.
//    "Z"
//        Take a set of readings and save them as the at-rest values.
// ----------Output
//    “*StarBurst* Spaceball Diagnostic Firmware v<major>.<minor>”
//        Printed on reset.
//    “Sn  <period>ms | <reading> = <rawReading> - <atRestReading> |
//      <LEDmA:PDuA ratio>:1 = <LEDmA>mA(<DAC setting>) : <PDuA>uA(<ADC value>)”
//    “<period> <reading1> <reading2> <reading3> <reading4> <reading5>
//      <reading6>”
//

//========== Macros
// Provide a timeout macro. Not timed out while the subtraction overflows.
#define TIMED_OUT(timeout_tick, time_tick) (!((time_tick - timeout_tick) & 0x8000))

//========== Hardware configuration.

// The three LED tristate pins.
// Each pin name reflects the pin's configuration for LED's 123456 in
// order:
//     L-(OUTPUT,LOW), H-(OUTPUT,HIGH), T-(INPUT,LOW)
// These pin names reflect the interface circuit's signal names.
// In electronic circuits the use of "n" is used to invert the meaning
// of the following levels so a LOW pin output pulls the corresponding
// LED connection high and vice versa.
const uint8_t nTLLTHH_PIN = A5;
const uint8_t nLTHHTL_PIN = A1;
const uint8_t nHHTLLT_PIN = A4;

// The five DAC pins.
const uint8_t DAC_ON_PIN = 4;
const uint8_t DAC_0_PIN = 8;
const uint8_t DAC_1_PIN = 9;
const uint8_t DAC_2_PIN = 10;
const uint8_t DAC_3_PIN = 11;

// The DAC controls the voltage across R12, a 27 ohm resistor, to control
// the LED drive iLEDDrive_mA. R12 is connected to pin 26 (A7).
const uint8_t V_LED_DRIVE_PIN = A7;
const int LED_DRIVE_OHM = 27;

// The photodiode iLEDDrive_mA generated by the light falling on it is drawn
// from 3.3V through R14, a 56K resistor.
const uint8_t V_PD_SENSE_PIN = A0;
const int PD_SENSE_KOHM = 56;  // 56K iLEDDrive_mA sense resistor

// Specify the HIGH pin and the LOW pin to turn on LEDs 1 through 6.
const uint8_t SENSOR_DRIVES[][2] = {
  { nHHTLLT_PIN, nLTHHTL_PIN },  // L1 H1
  { nHHTLLT_PIN, nTLLTHH_PIN },  // L2 H2
  { nLTHHTL_PIN, nTLLTHH_PIN },  // L3 H3
  { nLTHHTL_PIN, nHHTLLT_PIN },  // L4 H4
  { nTLLTHH_PIN, nHHTLLT_PIN },  // L5 H5
  { nTLLTHH_PIN, nLTHHTL_PIN }   // L6 H6
};

// The interface circuit connects pin 17 (3.3V) to pin 18 (AREF).
const float AREF_V = 3.3;

//========== Constants

const uint8_t SERIAL_BUFFER_SIZE = 64;

//========== Variables

struct AFlags {             // "A" for "aggregate" i.e. struct or union
  uint8_t singleState : 1;  // true indicates SINGLE state, false
                            // indicates SIX state
  uint8_t showPeriod : 1;   // Used to disable period for initial output.
  uint8_t setAtRest : 1;
} flags = { 1 };

uint8_t sensor = 0;

//The DAC settings for each sensor.
uint8_t dacSettings[6] = { 127, 127, 127, 127, 127, 127 };

// The at-rest ADC values for each sensor.
uint16_t atRest_adc[6] = { 512, 512, 512, 512, 512, 512 };

// Serial input buffer.
uint8_t serCount = 0;
char serBuf[SERIAL_BUFFER_SIZE];

// Use bits 9 to 24 of the micros() microsecond timer where 1 tick
// is 512 usec and which rolls over every 33.6 seconds providing
// a maximum 16.8 sec timeout. A 10 second time is the longest
// required.
const uint16_t USEC_PER_TICK = 1 << 9;
uint16_t timeout_tick, ticksPerCycle;
uint16_t rate_cyclesPer10Sec = 10;  // 0 to 600 - default to once every second

int vLEDDrive_adc;   // The ADC value of the R12 voltage controlling LED current.
float iLEDDrive_mA;  // The corresponding LED current.
int vPDSense_adc;    // The ADC value of the PD current-to-voltage circuit.
float iPDSense_uA;   // The corresponding photodiode current.

uint16_t previous_msec = 0;

//========== Code

void setup() {
  // put your setup code here, to run once:

  // Initialise the serial port and print the startup banner.
  Serial.begin(115200);
  Serial.println("*StarBurst* Spaceball Diagnostic v1.0");

  // MUST call analogReference() before analogueRead() otherwise the
  // first call to analogRead() will connect USBVCC (+5V) to AREF.
  analogReference(EXTERNAL);

  // Configure the two ADC pins.
  configurePin(V_LED_DRIVE_PIN, INPUT, LOW);
  configurePin(V_PD_SENSE_PIN, INPUT, LOW);

  // Initialise ticksPerCycle.
  // Unit analysis: ticks/cyc =  usec/10sec / usec/tick / cyc/10sec
  ticksPerCycle = 10000000L / USEC_PER_TICK / rate_cyclesPer10Sec;

  // Enter the SINGLE state.
  enterSingleState();
}

void loop() {
  // put your main code here, to run repeatedly:

  // Check for and process serial commands.
  if (checkSerialInput())
    processCommand();

  // Check for and handle a timeout.
  if (checkTimeout())
    runSensePrintCycle();
}

// Enter the SINGLE state which regularly outputs a single sensor reading.
void enterSingleState() {
  flags.singleState = true;

  // Turn on the LED and the DAC.
  turnOnLED(sensor);
  configurePin(DAC_ON_PIN, OUTPUT, HIGH);
  setDAC(dacSettings[sensor]);

  // Print the SINGLE state headings.
  printSINGLEStateHeading();

  // Run a SINGLE state sense/print cycle.
  takeAndPrintSingleReading();
  timeout_tick = ticks() + ticksPerCycle;
}

// Enter the SIX state which regularly outputs all six sensor readings.
void enterSixState() {
  flags.singleState = false;

  // Turn off the LED and run a SIX state sense/print cycle.
  turnOffLED();
  takeAndPrintAllReadings();
  timeout_tick = ticks() + ticksPerCycle;
}

// Time in ticks where each tick is 512 usec.
uint16_t ticks() {
  return (uint16_t)(micros() >> 9);
}

// Check if <timeout> has expired and if it has then update <timeout>.
bool checkTimeout() {
  bool timedout = false;

  if (rate_cyclesPer10Sec != 0) {  // Is the timeout running?
    // Get the current time.
    uint32_t now_tick = ticks();

    // Check for a timeout.
    timedout = TIMED_OUT(timeout_tick, now_tick);
    if (timedout) {
      // Update <timeout>.
      timeout_tick += ticksPerCycle;

      // Handle any debugging delays that may have caused an unexpected timeout.
      if (TIMED_OUT(timeout_tick, now_tick)) {
        tellError("Unexpected timeout");
        timeout_tick = now_tick + ticksPerCycle;
      }
    }
  }
  return timedout;
}

// Take and print a single reading.
void takeAndPrintSingleReading() {
  // Take the reading.
  takeReadingsCalculateCurrents();

  // Print the output.
  printSINGLEStateOutput();
}

// Take and print all six readings.
void takeAndPrintAllReadings() {
  // Output format:
  // “ <reading1> <reading2> <reading3> <reading4> <reading5> <reading6>”

  uint16_t elapsed_msec = millis() - previous_msec;
  previous_msec += elapsed_msec;  // Set to the millis() return value.

  String s = printIU16(elapsed_msec, 5);

  for (uint8_t i = 0; i < 6; i++) {
    // Apply the DAC setting, turn on the LED, wait 1msec, take a reading,
    // turn off the LED.
    setDAC(dacSettings[i]);
    turnOnLED(i);
    delay(1);  // wait 1 msec
    vPDSense_adc = 1024 - analogRead(V_PD_SENSE_PIN);
    turnOffLED();

    // Check if setting the at-rest values.
    if (flags.setAtRest)
      atRest_adc[i] = vPDSense_adc;

    s += String(" ") + printIU16(vPDSense_adc, 5);
  }
  flags.setAtRest = false;
  Serial.println(s);
}

// Print the SINGLE state's column headings.
void printSINGLEStateHeading() {
  Serial.println("Sn   msec  | dlta = raw - rst | ratio =  LEDmA(dac) :   PDµA( vPD)");
  // E.g.         S1  1000ms |  -15 = 523 - 508 | 200:1 = 20.3mA(127) : 10.1µA( 523)
}

// Print the output line for the single state.
void printSINGLEStateOutput() {
  // Variables

  uint16_t elapsed_msec = millis() - previous_msec;
  previous_msec += elapsed_msec;  // Set to the millis() return value.

  char buf[] = "S1 ";
  buf[1] += sensor;
  String s = String(buf);

  // Generate the period output.
  if (!flags.showPeriod)
    s += "   -    | ";
  else
    s += printIU16(elapsed_msec, 5) + "ms | ";
  flags.showPeriod = true;

  s += printIU16((int16_t)(vPDSense_adc - atRest_adc[sensor]), 3) + " = ";
  s += printIU16(vPDSense_adc, 3) + " - ";
  s += printIU16(atRest_adc[sensor], 3) + " | ";
  uint16_t ratio = (uint16_t)(iLEDDrive_mA * 1000 / iPDSense_uA + 0.5);
  s += (ratio > 999 ? "BIG" : printIU16(ratio, 3)) + ":1 = ";
  s += printIU16((uint16_t)(iLEDDrive_mA + 0.05), 2)
       + "." + (char)('0' + (uint16_t)(iLEDDrive_mA * 10 + 0.5) % 10) + "mA(";
  s += printIU16(dacSettings[sensor], 3) + ") : ";
  s += printIU16((uint16_t)(iPDSense_uA + 0.05), 2)
       + "." + (char)('0' + (uint16_t)(iPDSense_uA * 10 + 0.5) % 10) + "µA(";
  s += printIU16(vPDSense_adc, 4) + ")";
  Serial.println(s);
}

// Print unsigned word <u16> to field <width>.
String printIU16(uint16_t u16, uint8_t width) {
  return padLeft(String(u16), width);
}

// Print signed word <i16> to field <width>.
String printIU16(int16_t i16, uint8_t width) {
  return padLeft(String(i16), width);
}

// For up to 5-character strings pad the left with spaces.
String padLeft(String s, uint8_t width) {
  // Ensure width is valid.
  if ((width - 1) > 4) {
    tellError("Bad field width");
    width = 5;
  }

  static const char spaces5[] = "     ";
  uint8_t skip = 5 - width + s.length();
  return skip <= 5 ? String(spaces5 + skip) + s : s;
}

// Read in any and all serial input up to the next newline.
bool checkSerialInput() {
  bool lineReceived = false;

  while (Serial.available()) {
    char c = Serial.read();
    if (c == '\n') {
      serBuf[serCount] = '\0';  // null terminate
      lineReceived = true;
      break;
    }
    serBuf[serCount++] = c;
    if (serCount >= SERIAL_BUFFER_SIZE)
      serCount = 0;  // clear serBuf ignoring all received characters
  }
  return lineReceived;
}

// Run the sense/print cycle and reset the timeout.
void runSensePrintCycle() {
  if (flags.singleState)
    takeAndPrintSingleReading();
  else
    takeAndPrintAllReadings();
}

// Process the command in serBuf[].
void processCommand() {
  bool validCommand = true;

  // Note: serBuf[serCount] is '\0' and serCount is less than
  // SERIAL_BUFFER_SIZE.

  if (serBuf[0] >= 'a' && serBuf[0] <= 'z')
    serBuf[0] &= ~('a' - 'A');  // make upper case

  if (serCount > 0) {
    switch (serBuf[0]) {
      case '1':  // Set the SINGLE state.
        enterSingleState();
        break;

      case '6':  // Set the SIX state.
        enterSixState();
        break;

      case 'D':  // Perform the DAC test.
        dacTest();
        break;

      case 'R':  // Set the <rate>.
        uint32_t val32;
        if (serBuf[1] != '\0') {
          if (scanNumber(val32, 1))
            if (val32 > 600) {
              validCommand = false;
              break;
            }
          rate_cyclesPer10Sec = (uint16_t)val32;
          if (rate_cyclesPer10Sec != 0)
            ticksPerCycle = 10000000L / rate_cyclesPer10Sec
                            / USEC_PER_TICK;
        }
        Serial.println(String(rate_cyclesPer10Sec)
                       + " sense/print cycles every 10 seconds");
        goto onValidCommand;

      case 'Z':  // Take a set of at-rest readings.
        flags.setAtRest = true;
        takeAndPrintAllReadings();
        checkState();
        break;

      case 'S':  // Run a sense/print cycle and optionally set <sensor> and
                 // dacSettings[sensor].
        char c = serBuf[1];

        // Check for optional <sensor>.
        if (c != '\0') {
          if (c < '1' || c > '6') {
            validCommand = false;
            break;
          }

          // check for optional <dacSetting[sensor]>.
          if (serBuf[2] != '\0') {
            uint32_t val32;
            if (scanNumber(val32, 2))
              if (val32 <= 255) {

                // Assign the valid sensor and DAC setting value.
                sensor = serBuf[1] - '0' - 1;
                dacSettings[sensor] = (uint8_t)val32;
              }
          }
          // Assign the valid sensor value.
          sensor = serBuf[1] - '0' - 1;
        }
        Serial.println(serBuf);
        turnOffLED();
        checkState();
        goto onValidCommand;

      default:
        validCommand = false;
        break;

onValidCommand:
        // A valid command was received. Run the sense/print cycle.
        timeout_tick = ticks();  // Set the timeout timer to now.
        runSensePrintCycle();
        break;
    }
    if (!validCommand)
      Serial.println("Invalid command!");

    // Clear serBuf[].
    serCount = 0;
  }
}

void checkState() {
  if (flags.singleState) {
    setDAC(dacSettings[sensor]);
    turnOnLED(sensor);
    delay(1);
  } else
    turnOffLED();
}


// Scan a positive integer in serBuf[].
bool scanNumber(uint32_t& val32, uint8_t iSerBuf) {
  bool validNumber = true;

  // Require the first character to be a digit.
  char c = serBuf[iSerBuf++];
  if (isdigit(c)) {
    val32 = 0;
    for (uint8_t i = 0; i < 10; i++) {
      val32 = val32 * 10 + (c - '0');
      c = serBuf[iSerBuf++];
      if (!isdigit(c))
        break;
    }
  } else
    validNumber = false;
  return validNumber;
}

void dacTest() {
  Serial.println("Cycling through all 256 DAC settings...");

  // Cycle through all 256 DAC settings.
  Serial.println("DAC Setting\tLED mA, PD uA");
  uint8_t dacSetting = 0;
  do {
    // Apply the DAC setting.
    setDAC(dacSetting);
    delay(100);

    takeReadingsCalculateCurrents();

    // Print the results.
    String s;
    {  // Without this block the Arduino IDE gets confused.
      s = (dacSetting < 10) ? "  " : (dacSetting < 100) ? " "
                                                        : "";
    }
    s += String(dacSetting) + "\t" + String(vLEDDrive_adc) + "\t";
    s += ((iLEDDrive_mA < 10.0) ? " " : "") + String(iLEDDrive_mA, 1) + "\t";
    s += ((iPDSense_uA < 10.0) ? " " : "") + String(iPDSense_uA, 1);
    Serial.println(s);
  } while (++dacSetting);  // ends on rollover to 0

#if 1
  Serial.print("\nWaiting 10 seconds...");
  Serial.flush();
  delay(10000);  // wait 10 seconds.
  Serial.println("");
#endif
}

void takeReadingsCalculateCurrents() {
  // Take the LED vLEDDrive_adc and calculate the LED current in mA.
  vLEDDrive_adc = analogRead(V_LED_DRIVE_PIN);
  iLEDDrive_mA = vLEDDrive_adc * AREF_V * 1000 / (1024 * LED_DRIVE_OHM);

  // Take the photodiode vLEDDrive_adc and calculate the photodiode
  // current. Invert the ADC range 0 to 1023 to 1024 to 1.
  vPDSense_adc = 1024 - analogRead(V_PD_SENSE_PIN);
  const float FACTOR = AREF_V * 1000 / (1024.0 * PD_SENSE_KOHM);
  iPDSense_uA = vPDSense_adc * FACTOR;
}

char* lookupLEDPin(uint8_t pin) {
  static const uint8_t pinNumber[] = { A1, A4, A5 };
  static const char* pinName[] = { "A1", "A4", "A5" };

  return pin == pinNumber[0]   ? pinName[0]
         : pin == pinNumber[1] ? pinName[1]
         : pin == pinNumber[2] ? pinName[2]
                               : "XX";
}

void turnOnLED(uint8_t iSensor) {
  if (iSensor < 6) {  // Silently validate iSensor.
    // Turn on one of the sensor LEDs.
    configurePin(SENSOR_DRIVES[iSensor][0], OUTPUT, LOW);
    configurePin(SENSOR_DRIVES[iSensor][1], OUTPUT, HIGH);

    if (flags.singleState) {
      String s = lookupLEDPin(SENSOR_DRIVES[iSensor][0]);
      s += " is driven low (0V), ";
      s += lookupLEDPin(SENSOR_DRIVES[iSensor][1]);
      s += " is driven high (+5V)";
      Serial.println(s);
    }
  }
}

void turnOffLED() {
  configurePin(nHHTLLT_PIN, INPUT, LOW);
  configurePin(nLTHHTL_PIN, INPUT, LOW);
  configurePin(nTLLTHH_PIN, INPUT, LOW);
}

void setDAC(uint8_t dacSetting) {
  setDACPin(DAC_3_PIN, dacSetting >> 6);
  setDACPin(DAC_2_PIN, dacSetting >> 4);
  setDACPin(DAC_1_PIN, dacSetting >> 2);
  setDACPin(DAC_0_PIN, dacSetting);
}

// Configure the DAC pin as 0:OUTPUT/LOW, 1:INPUT/LOW,
// 2:INPUT_PULLUP/HIGH or 3:OUTPUT/HIGH.
void setDACPin(uint8_t pin, uint8_t dacPinSetting) {
  static const struct AsetDACPins {
    uint8_t inOutPullup, lowHigh;
  } dacPinConfigs[] = {
    { OUTPUT, LOW },         // 0V
    { INPUT, LOW },          // tristate
    { INPUT_PULLUP, HIGH },  // pull-up
    { OUTPUT, HIGH }         // USBVCC (+5V)
  };

  // Use bits 0 and 1 to select the list item.
  AsetDACPins const& config = dacPinConfigs[dacPinSetting & 3];
  configurePin(pin, config.inOutPullup, config.lowHigh);
}

// Configure a digital or analogue pin.
void configurePin(uint8_t pin, uint8_t mode, uint8_t val) {
  // Note: When configured as an INPUT a pin's internal pull-up resistor is
  // enabled by setting digitalWrite(pin,HIGH).

  pinMode(pin, mode);
  digitalWrite(pin, val);
}

void tellError(char const* message) {
  Serial.print("Error: ");
  Serial.println(message);
}